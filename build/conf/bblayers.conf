## build/conf/bblayers.conf
```bitbake
LCONF_VERSION = "7"

BBPATH = "${TOPDIR}"
BBFILES ?= ""

BBLAYERS ?= " \
    /home/hpsp/rock_space/xen_yocto/yocto_script_analysis/sources/core/meta \
    /home/hpsp/rock_space/xen_yocto/yocto_script_analysis/sources/core/meta-poky \
    /home/hpsp/rock_space/xen_yocto/yocto_script_analysis/sources/core/../meta-openembedded/meta-perl \
    /home/hpsp/rock_space/xen_yocto/yocto_script_analysis/sources/core/../meta-openembedded/meta-python \
    /home/hpsp/rock_space/xen_yocto/yocto_script_analysis/sources/core/../meta-openembedded/meta-filesystems \
    /home/hpsp/rock_space/xen_yocto/yocto_script_analysis/sources/core/../meta-openembedded/meta-gnome \
    /home/hpsp/rock_space/xen_yocto/yocto_script_analysis/sources/core/../meta-openembedded/meta-multimedia \
    /home/hpsp/rock_space/xen_yocto/yocto_script_analysis/sources/core/../meta-openembedded/meta-networking \
    /home/hpsp/rock_space/xen_yocto/yocto_script_analysis/sources/core/../meta-openembedded/meta-webserver \
    /home/hpsp/rock_space/xen_yocto/yocto_script_analysis/sources/core/../meta-openembedded/meta-xfce \
    /home/hpsp/rock_space/xen_yocto/yocto_script_analysis/sources/core/../meta-openembedded/meta-initramfs \
    /home/hpsp/rock_space/xen_yocto/yocto_script_analysis/sources/core/../meta-openembedded/meta-oe \
    /home/hpsp/rock_space/xen_yocto/yocto_script_analysis/sources/core/../meta-clang \
    /home/hpsp/rock_space/xen_yocto/yocto_script_analysis/sources/core/../meta-browser/meta-chromium \
    /home/hpsp/rock_space/xen_yocto/yocto_script_analysis/sources/core/../meta-qt5 \
    /home/hpsp/rock_space/xen_yocto/yocto_script_analysis/sources/core/../meta-xilinx/meta-microblaze \
    /home/hpsp/rock_space/xen_yocto/yocto_script_analysis/sources/core/../meta-xilinx/meta-xilinx-core \
    /home/hpsp/rock_space/xen_yocto/yocto_script_analysis/sources/core/../meta-xilinx/meta-xilinx-bsp \
    /home/hpsp/rock_space/xen_yocto/yocto_script_analysis/sources/core/../meta-xilinx/meta-xilinx-pynq \
    /home/hpsp/rock_space/xen_yocto/yocto_script_analysis/sources/core/../meta-xilinx/meta-xilinx-contrib \
    /home/hpsp/rock_space/xen_yocto/yocto_script_analysis/sources/core/../meta-xilinx/meta-xilinx-standalone \
    /home/hpsp/rock_space/xen_yocto/yocto_script_analysis/sources/core/../meta-xilinx/meta-xilinx-vendor \
    /home/hpsp/rock_space/xen_yocto/yocto_script_analysis/sources/core/../meta-xilinx-tools \
    /home/hpsp/rock_space/xen_yocto/yocto_script_analysis/sources/core/../meta-petalinux \
    /home/hpsp/rock_space/xen_yocto/yocto_script_analysis/sources/core/../meta-virtualization \
    /home/hpsp/rock_space/xen_yocto/yocto_script_analysis/sources/core/../meta-openamp \
    /home/hpsp/rock_space/xen_yocto/yocto_script_analysis/sources/core/../meta-jupyter \
    /home/hpsp/rock_space/xen_yocto/yocto_script_analysis/sources/core/../meta-vitis \
    /home/hpsp/rock_space/xen_yocto/yocto_script_analysis/sources/core/../meta-python2 \
    /home/hpsp/rock_space/xen_yocto/yocto_script_analysis/sources/core/../meta-som \
    /home/hpsp/rock_space/xen_yocto/yocto_script_analysis/sources/core/../meta-security \
    /home/hpsp/rock_space/xen_yocto/yocto_script_analysis/sources/core/../meta-security/meta-tpm \
    /home/hpsp/rock_space/xen_yocto/yocto_script_analysis/sources/core/../meta-xilinx-tsn \
    /home/hpsp/rock_space/xen_yocto/yocto_script_analysis/sources/core/../meta-ros/meta-ros-common \
    /home/hpsp/rock_space/xen_yocto/yocto_script_analysis/sources/core/../meta-ros/meta-ros2 \
    /home/hpsp/rock_space/xen_yocto/yocto_script_analysis/sources/core/../meta-ros/meta-ros2-humble \
"

BBLAYERS_NON_REMOVABLE ?= " \
    /home/hpsp/rock_space/xen_yocto/yocto_script_analysis/sources/core/meta \
"
```
